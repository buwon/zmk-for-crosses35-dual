&trackball_peripheral {
    cpi = <700>;  // 스크롤 속도 (기존 1000 → 700, 30% 감속)
    x-invert;
	/delete-property/ y-invert;
};

&trackball_peripheral_split {
	input-processors
		= <
		&zip_xy_to_scroll_mapper
		&zip_scroll_scaler 1 4   // 상하·좌우 스크롤 모두 1/4로 동일하게 감속
		&zip_ble_report_rate_limit
	>;
};
