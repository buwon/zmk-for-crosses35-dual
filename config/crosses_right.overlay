&trackball_central {
    cpi = <1000>;  // 커서 이동 속도 (700에서 저속 이동 시 커서가 잘 안 움직여 1000으로 복원)
};

// 우측 트랙볼 = 커서 이동 (움직이면 왼쪽 엄지에 클릭 활성화)
// 좌측 트랙볼 = 스크롤 (움직이면 오른쪽 엄지에 클릭 활성화)
//오토마우스 레이어 자동 이탈 설정 (양쪽 트랙볼 공용)
&zip_temp_layer {
    excluded-positions = < //아래는 오토마우스 레이어 중에도 눌러도 되는 키
		10 // GUI (hold)
		11 // ALT (hold)
		12 // CTRL (hold)
		13 // SHIFT (hold)
		21 // RALT
		30 // MCLK (left thumb)
		31 // LCLK (left thumb)
		32 // RCLK (left thumb)
		33 // RCLK (right thumb)
		34 // LCLK (right thumb)
		35 // MCLK (right thumb)
    >;
	require-prior-idle-ms = <300>; //레이어 전환 오작동 방지
};

// 우측(central) 트랙볼: 로컬 센서 이벤트 → Mouse Auto 레이어 자동 활성화
// 레이어 8 = crosses.keymap의 U_MOUSE_AUTO(mouse_auto_layer). 엄지 클릭 버튼 외
// 전부 &trans라서, 자동 활성화 중에도 타이핑에 영향을 주지 않음.
// (수동으로 엄지 홀드해 들어가는 U_MOUSE(2)는 모디파이어/단축키를 그대로 유지)
&trackball_central_listener {
    status = "okay";
    device = <&trackball_central>;
    input-processors = <
		&zip_ble_report_rate_limit
		&zip_temp_layer 8 1000 //트랙볼 움직이면 Mouse Auto 레이어(8) 자동 활성화, 1초간 유지
	>;
};

// 좌측(peripheral) 트랙볼: split 링크로 전달받은 스크롤 이벤트 → 같은 Mouse Auto 레이어 자동 활성화
&trackball_peripheral_listener {
    status = "okay";
    input-processors = <
		&zip_ble_report_rate_limit
		&zip_temp_layer 8 1000 //좌측 트랙볼(스크롤) 움직여도 동일하게 Mouse Auto 레이어 자동 활성화
	>;
};
